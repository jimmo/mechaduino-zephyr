## boards/arm/mechaduino/Kconfig.board
```kconfig
# Mechaduino Board configuration

config BOARD_MECHADUINO
	bool "Mechaduino"
	depends on SOC_PART_NUMBER_SAMD21G18A
```

## boards/arm/mechaduino/Kconfig.defconfig
```kconfig
# Mechaduino board configuration

config BOARD
	default "mechaduino"
	depends on BOARD_MECHADUINO
```

## drivers/sensor/as5048a/Kconfig
```kconfig
# AS5048A Angular position sensor configuration option

# Copyright (c) 2024, Jim Mussared.
# SPDX-License-Identifier: Apache-2.0

config AS5048A
    bool "AS5048A Angular position sensor"
    default y
    depends on DT_HAS_AMS_AS5048A_ENABLED
    select SPI
    help
      Enable driver for AS5048A Angular position sensor.
```

## dts/bindings/sensor/ams,as5048a.yaml
```yaml
# Copyright (c) 2019, Linaro Limited
# SPDX-License-Identifier: Apache-2.0

description: AMS AS5048A Angular position sensor

compatible: "ams,as5048a"

include: [sensor-device.yaml, spi-device.yaml]
```

## dts/bindings/stepper/allegro,a4954.yaml
```yaml
description: |
  Allegro A4954 - Dual Full-Bridge DMOS PWM Motor Driver

  Example definition in devicetree:

    stepper {
        compatible = "allegro,a4954";
        gpios = <&porta 6 0>, <&porta 21 0>, <&porta 15 0>, <&porta 20 0>;
        pwms = <&tcc1 1 PWM_USEC(10)>, <&tcc1 0 PWM_USEC(10)>;
    };

compatible: "allegro,a4954"

include: base.yaml

properties:
  gpios:
    type: phandle-array
    required: true
    description: IN1, IN2, IN3, IN4

  pwms:
    type: phandle-array
    required: true
    description: VREF12, VREF34
```
